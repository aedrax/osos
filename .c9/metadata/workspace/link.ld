{"filter":false,"title":"link.ld","tooltip":"/link.ld","undoManager":{"mark":1,"position":1,"stack":[[{"group":"doc","deltas":[{"start":{"row":0,"column":0},"end":{"row":25,"column":1},"action":"remove","lines":["ENTRY(loader)                /* the name of the entry label */","","SECTIONS {","    . = 0x00100000;          /* the code should be loaded at 1 MB */","","    .text ALIGN (0x1000) :   /* align at 4 KB */","    {","        *(.text)             /* all text sections from all files */","    }","","    .rodata ALIGN (0x1000) : /* align at 4 KB */","    {","        *(.rodata*)          /* all read-only data sections from all files */","    }","","    .data ALIGN (0x1000) :   /* align at 4 KB */","    {","        *(.data)             /* all data sections from all files */","    }","","    .bss ALIGN (0x1000) :    /* align at 4 KB */","    {","        *(COMMON)            /* all COMMON sections from all files */","        *(.bss)              /* all bss sections from all files */","    }","}"]},{"start":{"row":0,"column":0},"end":{"row":25,"column":1},"action":"insert","lines":["ENTRY(loader)                /* the name of the entry label */","","SECTIONS {","    . = 0x00100000;          /* the code should be loaded at 1 MB */","","    .text ALIGN (0x1000) :   /* align at 4 KB */","    {","        *(.text)             /* all text sections from all files */","    }","","    .rodata ALIGN (0x1000) : /* align at 4 KB */","    {","        *(.rodata*)          /* all read-only data sections from all files */","    }","","    .data ALIGN (0x1000) :   /* align at 4 KB */","    {","        *(.data)             /* all data sections from all files */","    }","","    .bss ALIGN (0x1000) :    /* align at 4 KB */","    {","        *(COMMON)            /* all COMMON sections from all files */","        *(.bss)              /* all bss sections from all files */","    }","}"]}]}],[{"group":"doc","deltas":[{"start":{"row":23,"column":14},"end":{"row":23,"column":15},"action":"insert","lines":["*"]}]}]]},"ace":{"folds":[],"scrolltop":0,"scrollleft":0,"selection":{"start":{"row":23,"column":15},"end":{"row":23,"column":15},"isBackwards":true},"options":{"guessTabSize":true,"useWrapMode":false,"wrapToView":true},"firstLineState":0},"timestamp":1423201976927,"hash":"f647f31d3ef153d73405188026b72a66b63d21a2"}